/*
 * Copyright 2016 Nelson Integration LLC
 *
 * The code contained herein is licensed under the GNU General Public
 * License. You may obtain a copy of the GNU General Public License
 * Version 2 or later at the following locations:
 *
 * http://www.opensource.org/licenses/gpl-license.html
 * http://www.gnu.org/copyleft/gpl.html
 */

	pinctrl_j12: j12grp {
		fsl,pins = <
			MX6QDL_PAD_EIM_A16__IPU2_CSI1_PIXCLK	0x100b0
			MX6QDL_PAD_EIM_A17__IPU2_CSI1_DATA12	0x100b0
			MX6QDL_PAD_EIM_A18__IPU2_CSI1_DATA13	0x100b0
			MX6QDL_PAD_EIM_A19__IPU2_CSI1_DATA14	0x100b0
			MX6QDL_PAD_EIM_A20__IPU2_CSI1_DATA15	0x100b0
			MX6QDL_PAD_EIM_A21__IPU2_CSI1_DATA16	0x100b0
			MX6QDL_PAD_EIM_A22__IPU2_CSI1_DATA17	0x100b0
			MX6QDL_PAD_EIM_A23__IPU2_CSI1_DATA18	0x100b0
			MX6QDL_PAD_EIM_A24__IPU2_CSI1_DATA19	0x100b0
			MX6QDL_PAD_EIM_DA0__IPU2_CSI1_DATA09	0x100b0
			MX6QDL_PAD_EIM_DA1__IPU2_CSI1_DATA08	0x100b0
			MX6QDL_PAD_EIM_DA11__IPU2_CSI1_HSYNC	0x100b0
			MX6QDL_PAD_EIM_DA12__IPU2_CSI1_VSYNC	0x100b0
			MX6QDL_PAD_EIM_DA13__GPIO3_IO13		0x100b0
			MX6QDL_PAD_EIM_DA14__GPIO3_IO14		0x100b0
			MX6QDL_PAD_EIM_DA15__GPIO3_IO15		0x100b0
			MX6QDL_PAD_EIM_DA2__IPU2_CSI1_DATA07	0x100b0
			MX6QDL_PAD_EIM_DA3__IPU2_CSI1_DATA06	0x100b0
			MX6QDL_PAD_EIM_DA4__IPU2_CSI1_DATA05	0x100b0
			MX6QDL_PAD_EIM_DA5__IPU2_CSI1_DATA04	0x100b0
			MX6QDL_PAD_EIM_DA6__IPU2_CSI1_DATA03	0x100b0
			MX6QDL_PAD_EIM_DA7__IPU2_CSI1_DATA02	0x100b0
			MX6QDL_PAD_EIM_DA8__IPU2_CSI1_DATA01	0x100b0
			MX6QDL_PAD_EIM_DA9__IPU2_CSI1_DATA00	0x100b0
			MX6QDL_PAD_EIM_EB0__IPU2_CSI1_DATA11	0x100b0
			MX6QDL_PAD_EIM_EB1__IPU2_CSI1_DATA10	0x100b0
			MX6QDL_PAD_EIM_EB2__GPIO2_IO30		0x100b0
			MX6QDL_PAD_EIM_EB3__GPIO2_IO31		0x100b0
			MX6QDL_PAD_EIM_LBA__GPIO2_IO27		0x100b0
			MX6QDL_PAD_EIM_RW__GPIO2_IO26		0x100b0
			MX6QDL_PAD_EIM_WAIT__GPIO5_IO00		0x100b0
		>;
	};

	pinctrl_j5: j5grp { /* parallel camera on Nitrogen6x */
		fsl,pins = <
			MX6QDL_PAD_CSI0_DAT12__UART4_TX_DATA	0x1b0b0
			MX6QDL_PAD_CSI0_DAT13__UART4_RX_DATA	0x1b0b0
			MX6QDL_PAD_CSI0_DAT14__UART5_TX_DATA	0x1b0b0
			MX6QDL_PAD_CSI0_DAT15__UART5_RX_DATA	0x1b0b0
			MX6QDL_PAD_CSI0_DAT16__GPIO6_IO02	0x1b0b0
			MX6QDL_PAD_CSI0_DAT17__GPIO6_IO03	0x1b0b0
			MX6QDL_PAD_CSI0_DAT18__GPIO6_IO04	0x1b0b0
			MX6QDL_PAD_CSI0_DAT19__GPIO6_IO05	0x1b0b0
			MX6QDL_PAD_CSI0_DATA_EN__GPIO5_IO20	0x1b0b0
			MX6QDL_PAD_CSI0_PIXCLK__GPIO5_IO18	0x1b0b0
			MX6QDL_PAD_CSI0_MCLK__GPIO5_IO19	0x1b0b0
			MX6QDL_PAD_CSI0_VSYNC__GPIO5_IO21	0x1b0b0
			MX6QDL_PAD_GPIO_3__GPIO1_IO03		0x1b0b0
			MX6QDL_PAD_GPIO_8__GPIO1_IO08		0x1b0b0
		>;
	};

